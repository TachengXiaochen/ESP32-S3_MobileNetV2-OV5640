## main/Kconfig.projbuild
```kconfig
menu "CAM AI Configuration"

    config CAM_AI_ENABLE_WEB_SERVER
        bool "Enable Web debug server (SoftAP + MJPEG + REST API)"
        default n
        help
            Enable WiFi SoftAP, HTTP server, MJPEG /stream and SPIFFS web UI.
            Disable for IoT track production to save flash/RAM and avoid
            WiFi/camera contention with AI inference.

    menu "L610 MQTT (EMQX Cloud)"

        config L610_MQTT_BROKER_HOST
            string "MQTT Broker Host"
            default "h13f6185.ala.cn-hangzhou.emqxsl.cn"

        config L610_MQTT_BROKER_PORT
            int "MQTT Broker Port"
            default 8883

        config L610_MQTT_USERNAME
            string "MQTT Username"
            default ""

        config L610_MQTT_PASSWORD
            string "MQTT Password"
            default ""

        config L610_MQTT_CLIENT_ID_STR
            string "MQTT Client ID (max 23 bytes)"
            default "esp32_s3cam"
    endmenu

endmenu
```

## sdkconfig.defaults
```kconfig
# CAM AI — committed defaults (no secrets)
# Credentials: copy sdkconfig.defaults.local.example → sdkconfig.defaults.local

CONFIG_CAM_AI_ENABLE_WEB_SERVER=n

CONFIG_L610_MQTT_BROKER_HOST="h13f6185.ala.cn-hangzhou.emqxsl.cn"
CONFIG_L610_MQTT_BROKER_PORT=8883
CONFIG_L610_MQTT_CLIENT_ID_STR="esp32_s3cam"
```
